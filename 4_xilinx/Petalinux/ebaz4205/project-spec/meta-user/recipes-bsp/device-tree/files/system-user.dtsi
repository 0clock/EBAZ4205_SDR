/include/ "system-conf.dtsi"
/ {
};

#define GPIO_ACTIVE_HIGH 0
#define GPIO_ACTIVE_LOW  1

&spi0 {
    st7789v@0 {
        status = "okay";
        compatible = "sitronix,st7789v";
       	reg = <0>;
       	spi-max-frequency =<32000000>;      
       	rotate =<270>;
       	spi-cpol;
       	spi-cpha;
       	rgb;                           
       	fps =<30>;                      
       	buswidth =<8>;                  
        reset-gpios=<&gpio0 55 GPIO_ACTIVE_HIGH>;   
       	dc-gpios   =<&gpio0 54 GPIO_ACTIVE_LOW>;   
	width  	   = <172>;
        height     = <320>;
       	debug 	   =<0>;              
        };
};
